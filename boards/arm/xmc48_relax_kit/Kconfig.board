## boards/arm/xmc48_relax_kit/Kconfig.board
```kconfig
config BOARD_XMC48_RELAX_KIT
	bool "Infineon Relax Kit"
	depends on SOC_SERIES_XMC_4XXX
	select SOC_PART_NUMBER_F144K2048
```

## boards/arm/xmc48_relax_kit/Kconfig.defconfig
```kconfig
if BOARD_XMC48_RELAX_KIT

config BOARD
	default "xmc48_relax_kit"

endif # BOARD_XMC48_RELAX_KIT
```

## boards/arm/xmc48_relax_kit/xmc48_relax_kit_defconfig
```kconfig
CONFIG_BOARD_XMC48_RELAX_KIT=y
CONFIG_SOC_SERIES_XMC_4XXX=y
CONFIG_SOC_XMC4800=y
CONFIG_ARM_MPU=y

# enable uart driver
CONFIG_SERIAL=y

# enable console
CONFIG_CONSOLE=y
CONFIG_UART_CONSOLE=y
```

## manifest/west.yml
```yaml
# https://docs.zephyrproject.org/3.1.0/develop/west/manifest.html

# https://github.com/zephyrproject-rtos/zephyr/issues/35075

manifest:

  remotes:
    - name: zephyr
      url-base: https://github.com/zephyrproject-rtos
    - name: cooked
      url-base: https://github.com/cooked

  projects:
    - name: zephyr
      remote: cooked
      repo-path: zephyr
      revision: main #v3.2.0
      import:
        name-allowlist:
          - cmsis

    # use development hal_infineon
    - name: hal_infineon
      remote: zephyr
      repo-path: hal_infineon
      path: modules/hal/infineon
```
